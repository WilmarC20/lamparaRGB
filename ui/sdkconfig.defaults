## ui/sdkconfig.defaults
```kconfig
# Liberar IRAM (Arduino ESP32 aplica si recompila el framework)
CONFIG_ESP_WIFI_IRAM_OPT=n
CONFIG_ESP_WIFI_RX_IRAM_OPT=n
CONFIG_BT_CTRL_RUN_IN_FLASH=y
CONFIG_BT_BTM_RUN_IN_FLASH=y
CONFIG_BT_BLE_RUN_IN_FLASH=y
```
